#include "slcan_tools.h"

#include "can_suite.h"
#include "core/display.h"
#include "core/operation_control.h"
#include "core/sd_functions.h"
#include <SD.h>
#include <globals.h>
#include <time.h>

namespace {
using namespace Automotive;
constexpr uint16_t C_BG = TFT_BLACK;
constexpr uint16_t C_CYAN = TFT_CYAN;
constexpr uint16_t C_AMBER = 0xFD20;
constexpr uint16_t C_GREEN = TFT_GREEN;
constexpr uint16_t C_RED = TFT_RED;

String captureName() {
    time_t now = time(nullptr);
    struct tm value;
    if (now > 1609459200 && localtime_r(&now, &value)) {
        char name[48];
        strftime(name, sizeof(name), "/Automotive/captures/%Y%m%d_%H%M%S.asc", &value);
        return name;
    }
    static uint32_t bootCapture = 0;
    return "/Automotive/captures/boot_" + String(++bootCapture) + ".asc";
}

void shell(const char *title, int page, int total, const char *action, bool connected) {
    tft.fillScreen(C_BG);
    tft.setTextSize(FP); tft.setTextColor(C_CYAN, C_BG); tft.drawString(title, 7, 5, 1);
    String status = String(sdcardMounted ? "SD " : "-- ") + (connected ? "CAN " : "UART ") + String(getBattery()) + "%";
    tft.setTextColor(connected ? C_GREEN : C_AMBER, C_BG); tft.drawRightString(status, tftWidth - 6, 5, 1);
    tft.drawFastHLine(6, 20, tftWidth - 12, C_CYAN);
    tft.setTextColor(C_AMBER, C_BG); tft.drawString(String(page) + "/" + String(total), 7, tftHeight - 13, 1);
    tft.setTextColor(C_CYAN, C_BG); tft.drawRightString(action, tftWidth - 7, tftHeight - 13, 1);
}

void ascHeader(File &file, uint32_t bitrate) {
    file.println("date generated by M5 Sentinel");
    file.println("base hex  timestamps absolute");
    file.printf("// bitrate %lu bit/s\n", static_cast<unsigned long>(bitrate));
    file.println("Begin Triggerblock");
}

void ascFrame(File &file, const CanFrame &frame, uint32_t origin) {
    char id[10]; snprintf(id, sizeof(id), frame.extended ? "%08lXx" : "%03lX", static_cast<unsigned long>(frame.id));
    file.printf("%10.6f 1  %s %-2s %c %u", (frame.timestampMs - origin) / 1000.0, id,
                frame.rtr ? "r" : "d", frame.tx ? 'T' : 'R', frame.dlc);
    if (!frame.rtr) for (uint8_t i = 0; i < frame.dlc; ++i) file.printf(" %02X", frame.data[i]);
    file.println();
}

bool beginCan(uint32_t bitrate) {
    return startTransport(bitrate, BAD_RX, BAD_TX);
}

bool stopRequested(bool allowSelect = true) {
    (void)allowSelect;
    return operationExitRequested();
}

void armOperationStop() {
    armOperationExit();
}

bool waitInterruptible(uint32_t durationUs) {
    while (durationUs) {
        if (stopRequested()) return false;
        uint32_t slice = durationUs > 10000 ? 10000 : durationUs;
        delayMicroseconds(slice);
        durationUs -= slice;
    }
    return true;
}

bool confirmTxUnlock() {
    shell("ATTENTION TX",5,7,"MAINTENIR M5",false);
    tft.setTextSize(FP); tft.setTextColor(C_RED,C_BG); tft.setCursor(8,30);
    tft.println("Emission sur bus CAN"); tft.println("Banc ou vehicule autorise");
    tft.println("Maintenir M5 1.5 seconde"); tft.println("Power: annuler");
    while (SelPress) delay(10);
    uint32_t heldAt=0;
    while (!check(EscPress)) {
        if (SelPress) { if (!heldAt) heldAt=millis(); if (millis()-heldAt>=1500) return unlockTransmission(); }
        else heldAt=0;
        delay(10);
    }
    return false;
}

void drawLive(uint32_t bitrate, uint32_t frames, uint32_t started, const CanFrame *last, const String &path) {
    CanTransportStatus state=transportStatus();
    shell("CAN CAPTURE", 4, 7, "2x HAUT: STOP", state.connected);
    tft.setTextSize(FM); tft.setCursor(8, 28); tft.setTextColor(C_AMBER, C_BG);
    float rate = millis() == started ? 0 : frames * 1000.0f / (millis() - started);
    tft.printf("%lu k  %.1f tr/s\n", static_cast<unsigned long>(bitrate / 1000), rate);
    tft.printf("IDs %u  total %lu\n", activity().items().size(), static_cast<unsigned long>(frames));
    if (last) {
        tft.setTextColor(C_CYAN, C_BG); tft.printf("ID %s%lX DLC %u\n", last->extended ? "x" : "", static_cast<unsigned long>(last->id), last->dlc);
        for (uint8_t i=0;i<last->dlc;i++) { const CanIdStats *s=activity().find(last->id,last->extended); tft.setTextColor(s && (s->changedMask&(1U<<i)) ? C_AMBER : C_CYAN, C_BG); tft.printf("%02X ",last->data[i]); }
    }
    tft.setTextSize(FP); tft.setTextColor(state.errors ? C_RED : C_CYAN,C_BG); tft.setCursor(8,101); tft.print(String(transport().name())+" "+(state.listenOnly?"LISTEN ":"TX ")+path.substring(path.lastIndexOf('/')+1));
}
} // namespace

namespace SlcanTools {

void dashboard(uint32_t bitrate) {
    if (!beginCan(bitrate)) { displayError(transportStatus().lastError, true); return; }
    armOperationStop();
    uint32_t started=millis(), frames=0, drawAt=0; CanFrame frame, last; bool have=false;
    while (!stopRequested()) {
        for (uint8_t batch=0; batch<32 && transport().poll(frame); ++batch) {
            activity().update(frame); last=frame; have=true; frames++;
        }
        if (millis()-drawAt>200) { drawAt=millis(); drawLive(bitrate,frames,started,have?&last:nullptr,"LIVE"); }
        delay(1);
    }
    stopTransport();
}

void activeIds() {
    armOperationStop();
    size_t index=0;
    while (!stopRequested(false)) {
        const auto &ids=activity().items(); if (!ids.empty()) { if (check(NextPress)) index=(index+1)%ids.size(); if (check(PrevPress)) index=(index+ids.size()-1)%ids.size(); }
        shell("ACTIVE IDS",2,7,"2x HAUT: RETOUR",transportStatus().connected); tft.setCursor(8,29); tft.setTextSize(FM);
        if (ids.empty()) { tft.setTextColor(C_CYAN,C_BG); tft.println("Aucune trame"); }
        else { const auto &s=ids[index]; tft.setTextColor(C_CYAN,C_BG); tft.printf("%s%lX  %lu\n",s.extended?"x":"",(unsigned long)s.id,(unsigned long)s.count); tft.printf("%.1f Hz mask %02X\n",s.frequencyHz,s.changedMask); for(uint8_t i=0;i<s.lastFrame.dlc;i++)tft.printf("%02X ",s.lastFrame.data[i]); }
        delay(80);
    }
}

void capture(uint32_t bitrate) {
    if (!setupSdCard()) { displayError("Carte SD absente", true); return; }
    SD.mkdir("/Automotive"); SD.mkdir("/Automotive/captures"); String path=captureName(); File output=SD.open(path,FILE_WRITE);
    if (!output) { displayError("Creation ASC impossible",true); return; }
    if (!beginCan(bitrate)) { output.close(); displayError(transportStatus().lastError,true); return; }
    armOperationStop();
    ascHeader(output,bitrate); activity().clear(); uint32_t origin=millis(),frames=0,drawAt=0,lastFlush=0; CanFrame frame,last; bool have=false;
    while (!stopRequested()) {
        for (uint8_t batch=0; batch<32 && transport().poll(frame); ++batch) {
            activity().update(frame); ascFrame(output,frame,origin); last=frame; have=true; frames++;
        }
        if(millis()-drawAt>250){drawAt=millis();drawLive(bitrate,frames,origin,have?&last:nullptr,path);}
        if (frames - lastFlush >= 64) { output.flush(); lastFlush = frames; }
        delay(1);
    }
    output.println("End TriggerBlock"); output.close(); stopTransport();
}

void replay(uint32_t bitrate) {
    if (!setupSdCard()) { displayError("Carte SD absente",true); return; }
    String path=loopSD(SD,true,"ASC","/Automotive/captures"); if(!path.length())return; File input=SD.open(path,FILE_READ); if(!input){displayError("Fichier illisible",true);return;}
    if(!beginCan(bitrate)){input.close();displayError(transportStatus().lastError,true);return;}
    if(!confirmTxUnlock()){input.close();stopTransport();displayError("Emission verrouillee",true);return;}
    armOperationStop();
    float speed=1.0f; uint32_t sent=0,previousUs=0; // ASC parser accepts the format emitted above.
    while(input.available() && !stopRequested()){
        String line=input.readStringUntil('\n'); line.trim(); if(!line.length()||!isdigit(line[0]))continue;
        double seconds=line.substring(0,line.indexOf(' ')).toDouble(); uint32_t currentUs=seconds*1000000.0;
        int p=line.indexOf(" 1  "); if(p<0)continue; String rest=line.substring(p+4); rest.trim();
        int space=rest.indexOf(' '); String idText=rest.substring(0,space); bool ext=idText.endsWith("x"); if(ext)idText.remove(idText.length()-1); CanFrame f; f.id=strtoul(idText.c_str(),nullptr,16); f.extended=ext;
        rest=rest.substring(space);rest.trim(); f.rtr=rest[0]=='r'; space=rest.indexOf(' ');rest=rest.substring(space);rest.trim(); space=rest.indexOf(' ');rest=rest.substring(space);rest.trim(); f.dlc=rest.substring(0,rest.indexOf(' ')).toInt();
        for(uint8_t i=0;i<f.dlc&&!f.rtr;i++){space=rest.indexOf(' ');if(space<0)break;rest=rest.substring(space);rest.trim();f.data[i]=strtoul(rest.substring(0,2).c_str(),nullptr,16);}
        if (previousUs && currentUs > previousUs &&
            !waitInterruptible(static_cast<uint32_t>((currentUs-previousUs)/speed))) {
            break;
        }
        previousUs=currentUs;
        if(transport().send(f))sent++;
        shell("CAN REPLAY",5,7,"2x HAUT: STOP",true);tft.setCursor(8,33);tft.setTextSize(FM);tft.setTextColor(C_AMBER,C_BG);tft.printf("%.2fx  %lu trames",speed,(unsigned long)sent);
    }
    input.close();stopTransport();
}

void wiringInfo() {
    shell("CONFIGURATION",7,7,"M5: RETOUR",false); tft.setTextSize(FP);tft.setTextColor(C_CYAN,C_BG);tft.setCursor(8,29);
    tft.println("G32 TX -> RX SLCAN");tft.println("G33 RX <- TX SLCAN");tft.println("GND commun / 3.3 V");tft.println("UART 115200, CAN classique");tft.println("Grove partage PM3/CAN");
    while(!check(EscPress)&&!check(SelPress))delay(20);
}
} // namespace SlcanTools
